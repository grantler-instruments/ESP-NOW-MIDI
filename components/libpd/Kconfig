## components/libpd/Kconfig
```kconfig
menu "libpd"

config LIBPD_FLOAT_DSP
    bool "Use single-precision DSP optimisations"
    default y
    help
        Optimise the Pd 0.56-5 maths, oscillator, table lookup and vline DSP
        routines for processors without hardware double precision. Scheduling
        timestamps remain double precision. Disable for stock Pd routines.

config LIBPD_IRAM_DSP
    bool "Place common Pd DSP routines in IRAM"
    depends on IDF_TARGET_ESP32S3
    default n
    help
        Place current arithmetic, buffers, envelopes, filters, oscillators,
        interpolated table and delay reads, maths and DSP dispatch routines
        in internal instruction RAM. Includes scalar and unrolled variants.
        Consumes internal SRAM otherwise available for data and heap.
        This improves instruction placement, not full cache-disabled safety:
        called helpers and signal/table data can remain in flash or PSRAM.
        Disable to restore normal flash placement without changing DSP code.

endmenu
```

## examples_idf/client_pd/main/Kconfig.projbuild
```kconfig
menu "client_pd (enomik + Pure Data)"

    config CLIENT_PD_SAMPLE_RATE
        int "Sample rate (Hz)"
        default 48000

    config CLIENT_PD_TICKS
        int "Pd blocks per audio buffer (64 samples each)"
        range 1 16
        default 2
        help
            Latency vs. CPU headroom. 2 ticks = 128 frames = 2.7 ms at 48 kHz.

    config CLIENT_PD_CORE
        int "CPU core for the Pd task"
        range 0 1
        default 1

    config CLIENT_PD_AUDIO
        bool "I2S audio (adc~ / dac~)"
        default y
        help
            Off: control-only. Pd still runs, ticked by a timer at block rate,
            so MIDI logic works without any audio hardware.

    if CLIENT_PD_AUDIO
        config CLIENT_PD_I2S_MCLK
            int "I2S MCLK GPIO (-1 = unused)"
            default -1
        config CLIENT_PD_I2S_BCLK
            int "I2S BCLK GPIO"
            default 5
        config CLIENT_PD_I2S_WS
            int "I2S WS / LRCK GPIO"
            default 6
        config CLIENT_PD_I2S_DOUT
            int "I2S data out GPIO (to DAC, -1 = no dac~)"
            default 7
        config CLIENT_PD_I2S_DIN
            int "I2S data in GPIO (from ADC/mic, -1 = no adc~)"
            default 15
    endif

endmenu
```

## examples_idf/client_pd_waveshare_audio_s3/main/Kconfig.projbuild
```kconfig
menu "client_pd (Waveshare ESP32-S3-AUDIO)"

    config CLIENT_PD_SAMPLE_RATE
        int "Sample rate (Hz)"
        default 48000

    config CLIENT_PD_TICKS
        int "Pd blocks per audio buffer (64 samples each)"
        range 1 16
        default 2
        help
            Latency vs. CPU headroom. 2 ticks = 128 frames = 2.7 ms at 48 kHz.

    config CLIENT_PD_CORE
        int "CPU core for the Pd task"
        range 0 1
        default 1

    config CLIENT_PD_SPEAKER_VOLUME
        int "Speaker volume (ES8311, 0-100)"
        range 0 100
        default 70

    config CLIENT_PD_MIC_GAIN_DB
        int "Microphone gain (ES7210, dB)"
        range 0 37
        default 30

endmenu
```
